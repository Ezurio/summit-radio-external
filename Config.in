## Config.in
```kconfig
choice
	prompt "Radio Stack Bundles"
	optional

	config BR2_SUMMIT_CORE_60_RADIO
		bool "Core 60 Series Radio Stack Bundle"
		imply BR2_PACKAGE_SUMMIT_ADAPTIVE_BT if BR2_PACKAGE_BLUEZ5_UTILS
		imply BR2_PACKAGE_SUMMIT_ADAPTIVE_WW
		imply BR2_PACKAGE_SUMMIT_BT_UART_SCRIPTS_60 if BR2_PACKAGE_BLUEZ5_UTILS
		select BR2_PACKAGE_SUMMIT_FIRMWARE_60
		select BR2_PACKAGE_SUMMIT_LINUX_BACKPORTS
		imply BR2_PACKAGE_SUMMIT_NETWORK_MANAGER
		imply BR2_PACKAGE_SUMMIT_SUPPLICANT
		imply BR2_PACKAGE_SUMMIT_HOSTAPD
		help
		  This option selects the default Radio Stack bundle for a 60 Series radio module.
		  This option is suitable for any design using a 60 Series radio module.
		  The correct 60 Series firmware package must be manually selected in addition to this package.

	config BR2_SUMMIT_CORE_LWB_RADIO
		bool "Core Sona IF/Sterling LWBx Radio Stack Bundle"
		select BR2_PACKAGE_SUMMIT_FIRMWARE_LWB_IF
		select BR2_PACKAGE_SUMMIT_LINUX_BACKPORTS
		imply BR2_PACKAGE_SUMMIT_NETWORK_MANAGER
		imply BR2_PACKAGE_SUMMIT_SUPPLICANT
		imply BR2_PACKAGE_SUMMIT_HOSTAPD
		help
		  This option selects the default Radio Stack bundle for the Sona IF and Sterling LWBx radio modules.
		  This option is suitable for any design using a Sona IF or Sterling LWBx radio module.
		  The correct Sona IF or Sterling LWBx firmware package must be manually selected in addition to this package.

	config BR2_SUMMIT_CORE_NX_RADIO
		bool "Core Sona NX61x Radio Stack Bundle"
		select BR2_PACKAGE_SUMMIT_FIRMWARE_NX
		select BR2_PACKAGE_SUMMIT_LINUX_BACKPORTS
		imply BR2_PACKAGE_SUMMIT_NETWORK_MANAGER
		imply BR2_PACKAGE_SUMMIT_SUPPLICANT
		imply BR2_PACKAGE_SUMMIT_HOSTAPD
		help
		  This option selects the default Radio Stack bundle for a Sona NX radio module.
		  This option is suitable for any design using a Sona NX radio module.
		  The correct Sona NX firmware package must be manually selected in addition to this package.

	config BR2_SUMMIT_CORE_TI_RADIO
		bool "Core Sona TI Radio Stack Bundle"
		select BR2_PACKAGE_SUMMIT_FIRMWARE_TI
		select BR2_PACKAGE_SUMMIT_LINUX_BACKPORTS
		imply BR2_PACKAGE_SUMMIT_NETWORK_MANAGER
		imply BR2_PACKAGE_SUMMIT_SUPPLICANT
		imply BR2_PACKAGE_SUMMIT_HOSTAPD
		help
		  This option selects the default Radio Stack bundle for a Sona TI radio module.
		  This option is suitable for any design using a Sona TI radio module.
		  The correct Sona TI firmware package must be manually selected in addition to this package.

	config BR2_SUMMIT_SOM60_RADIO
		bool "SOM60 Radio Stack Bundle"
		select BR2_PACKAGE_SUMMIT_ADAPTIVE_BT if BR2_PACKAGE_BLUEZ5_UTILS
		select BR2_PACKAGE_SUMMIT_ADAPTIVE_WW
		select BR2_PACKAGE_SUMMIT_BT_UART_SCRIPTS_60 if BR2_PACKAGE_BLUEZ5_UTILS
		select BR2_PACKAGE_SUMMIT_FIRMWARE_60
		select BR2_PACKAGE_SUMMIT_FIRMWARE_60_SDIO_UART
		select BR2_PACKAGE_SUMMIT_LINUX_BACKPORTS
		select BR2_PACKAGE_SUMMIT_NETWORK_MANAGER
		select BR2_PACKAGE_SUMMIT_SUPPLICANT
		select BR2_PACKAGE_SUMMIT_SUPPLICANT_LIBS
		help
		  This option selects the Radio Stack bundle for the 60 Series SOM image.
		  This option is typically used only with the Ezurio 60 Series SOM.

	config BR2_SUMMIT_SOM8MP_RADIO
		bool "Summit SOM8MP Radio Stack Bundle"
		select BR2_PACKAGE_SUMMIT_ADAPTIVE_BT if BR2_PACKAGE_BLUEZ5_UTILS
		select BR2_PACKAGE_SUMMIT_ADAPTIVE_WW
		select BR2_PACKAGE_SUMMIT_FIRMWARE_60
		select BR2_PACKAGE_SUMMIT_FIRMWARE_60_SOM8MP
		select BR2_PACKAGE_SUMMIT_LINUX_BACKPORTS
		select BR2_PACKAGE_SUMMIT_NETWORK_MANAGER
		select BR2_PACKAGE_SUMMIT_SUPPLICANT
		select BR2_PACKAGE_SUMMIT_SUPPLICANT_LIBS
		help
		  This option selects the Radio Stack bundle for the Summit SOM 8M Plus image.
		  This option is typically used only with the Ezurio Summit SOM 8M Plus SOM.

	config BR2_SUMMIT_COMBO_IMAGE_RADIO
		bool "Combo SOM Image Radio Stack Bundle"
		select BR2_PACKAGE_SUMMIT_FIRMWARE_60
		select BR2_PACKAGE_SUMMIT_FIRMWARE_60_SDIO_UART
		select BR2_PACKAGE_SUMMIT_FIRMWARE_60_SDIO_SDIO
		select BR2_PACKAGE_SUMMIT_FIRMWARE_LWB_IF
		select BR2_PACKAGE_SUMMIT_FIRMWARE_LWB_IF_IF573_SDIO
		select BR2_PACKAGE_SUMMIT_FIRMWARE_LWB_IF_IF513_DIV
		select BR2_PACKAGE_SUMMIT_FIRMWARE_NX
		select BR2_PACKAGE_SUMMIT_FIRMWARE_NX61X
		select BR2_PACKAGE_SUMMIT_FIRMWARE_TI
		select BR2_PACKAGE_SUMMIT_LINUX_BACKPORTS
		select BR2_PACKAGE_SUMMIT_NETWORK_MANAGER
		select BR2_PACKAGE_SUMMIT_SUPPLICANT
		select BR2_PACKAGE_SUMMIT_HOSTAPD
		help
		  This option selects the default Radio Stack bundle for the Combo image.
		  This option is typically used only with Ezurio SOMs that support multiple radio modules.

	config BR2_SUMMIT_WB50N_SYSD_RADIO
		bool "WB50N SYSD Radio Stack Bundle"
		select BR2_PACKAGE_SUMMIT_FIRMWARE_MSD
		select BR2_PACKAGE_SUMMIT_FIRMWARE_MSD_50
		select BR2_PACKAGE_SUMMIT_LINUX_BACKPORTS
		select BR2_PACKAGE_SUMMIT_NETWORK_MANAGER
		select BR2_PACKAGE_SUMMIT_SUPPLICANT
		help
		  This option selects the Radio Stack bundle for the WB50N Modern image.
		  This option is typically used only with the Ezurio WB50N SOM.
		  

	config BR2_SUMMIT_WB50N_LEGACY_RADIO
		bool "WB50N Legacy Radio Stack Bundle"
		select BR2_PACKAGE_SUMMIT_FIRMWARE_MSD
		select BR2_PACKAGE_SUMMIT_FIRMWARE_MSD_50
		select BR2_PACKAGE_SUMMIT_LINUX_BACKPORTS
		select BR2_PACKAGE_SUMMIT_SUPPLICANT
		select BR2_PACKAGE_SUMMIT_SUPPLICANT_LEGACY
		help
		  This option selects the Radio Stack bundle for the WB50N Legacy image.
		  This option is typically used only with the Ezurio WB50N SOM.

	config BR2_SUMMIT_WB45N_LEGACY_RADIO
		bool "WB45N Legacy Radio Stack Bundle"
		select BR2_PACKAGE_SUMMIT_FIRMWARE_MSD
		select BR2_PACKAGE_SUMMIT_FIRMWARE_MSD_45
		select BR2_PACKAGE_SUMMIT_LINUX_BACKPORTS
		select BR2_PACKAGE_SUMMIT_SUPPLICANT
		select BR2_PACKAGE_SUMMIT_SUPPLICANT_LEGACY
		help
		  This option selects the Radio Stack bundle for the WB45N Legacy image.
		  This option is typically used only with the Ezurio WB45N SOM.

endchoice

config BR2_SUMMIT_60_RADIO
	bool
	default y if BR2_SUMMIT_SOM60_RADIO || BR2_SUMMIT_SOM8MP_RADIO || BR2_SUMMIT_CORE_60_RADIO

config BR2_SUMMIT_50_RADIO
	bool
	default y if BR2_SUMMIT_WB50N_SYSD_RADIO || BR2_SUMMIT_WB50N_LEGACY_RADIO

config BR2_SUMMIT_FIPS_RADIO
	bool "FIPS Radio"
	depends on BR2_SUMMIT_SOM60_RADIO || BR2_SUMMIT_50_RADIO || BR2_SUMMIT_WB45N_LEGACY_RADIO
	select BR2_PACKAGE_SUMMIT_SUPPLICANT_FIPS

config BR2_PACKAGE_SUMMIT_RADIO_STACK_ARCH
	string
	default "arm-eabihf" if BR2_arm && BR2_ARM_EABIHF
	default "arm-eabi" if BR2_arm && BR2_ARM_EABI
	default "aarch64" if BR2_aarch64
	default "powerpc64-e5500" if BR2_powerpc64
	default "powerpc" if BR2_powerpc
	default "x86" if BR2_i386
	default "x86_64" if BR2_x86_64

menu "Summit Radio Firmware"
source "$BR2_EXTERNAL_SUMMIT_RADIO_PATH/package/summit-firmware-60/Config.in"
source "$BR2_EXTERNAL_SUMMIT_RADIO_PATH/package/summit-firmware-lwb-if/Config.in"
source "$BR2_EXTERNAL_SUMMIT_RADIO_PATH/package/summit-firmware-nx/Config.in"
source "$BR2_EXTERNAL_SUMMIT_RADIO_PATH/package/summit-firmware-ti/Config.in"
source "$BR2_EXTERNAL_SUMMIT_RADIO_PATH/package/summit-firmware-msd/Config.in"
source "$BR2_EXTERNAL_SUMMIT_RADIO_PATH/package/summit-firmware-bdsdmac/Config.in"
endmenu

comment "Summit Radio Stack individual components"

source "$BR2_EXTERNAL_SUMMIT_RADIO_PATH/package/summit-linux-backports/Config.in"
source "$BR2_EXTERNAL_SUMMIT_RADIO_PATH/package/summit-supplicant/Config.in"
source "$BR2_EXTERNAL_SUMMIT_RADIO_PATH/package/summit-supplicant-libs/Config.in"
source "$BR2_EXTERNAL_SUMMIT_RADIO_PATH/package/summit-network-manager/Config.in"
source "$BR2_EXTERNAL_SUMMIT_RADIO_PATH/package/summit-hostapd/Config.in"
source "$BR2_EXTERNAL_SUMMIT_RADIO_PATH/package/summit-adaptive_bt/Config.in"
source "$BR2_EXTERNAL_SUMMIT_RADIO_PATH/package/summit-adaptive_ww/Config.in"
source "$BR2_EXTERNAL_SUMMIT_RADIO_PATH/package/summit-brcm-patchram-plus/Config.in"
source "$BR2_EXTERNAL_SUMMIT_RADIO_PATH/package/summit-bt-uart-scripts-60/Config.in"

menu "Summit Regulatory Tools"
source "$BR2_EXTERNAL_SUMMIT_RADIO_PATH/package/summit-reg45n/Config.in"
source "$BR2_EXTERNAL_SUMMIT_RADIO_PATH/package/summit-reg50n/Config.in"
source "$BR2_EXTERNAL_SUMMIT_RADIO_PATH/package/summit-mfg60n/Config.in"
source "$BR2_EXTERNAL_SUMMIT_RADIO_PATH/package/summit-regif513/Config.in"
source "$BR2_EXTERNAL_SUMMIT_RADIO_PATH/package/summit-regif573/Config.in"
source "$BR2_EXTERNAL_SUMMIT_RADIO_PATH/package/summit-regcypress/Config.in"
source "$BR2_EXTERNAL_SUMMIT_RADIO_PATH/package/summit-reglwbplus/Config.in"
source "$BR2_EXTERNAL_SUMMIT_RADIO_PATH/package/summit-reglwb5plus/Config.in"
source "$BR2_EXTERNAL_SUMMIT_RADIO_PATH/package/summit-mfg611/Config.in"
source "$BR2_EXTERNAL_SUMMIT_RADIO_PATH/package/summit-regti351/Config.in"
endmenu
```

## package/summit-firmware-bdsdmac/Config.in
```kconfig
config BR2_PACKAGE_SUMMIT_FIRMWARE_BDSDMAC
	bool "BD-SDMAC Radio Firmware"
	select BR2_PACKAGE_WIRELESS_REGDB
	select BR2_PACKAGE_SUMMIT_FIRMWARE_DEVEL if BR2_LRD_DEVEL_BUILD
	select BR2_PACKAGE_SUMMIT_FIRMWARE_DEVEL_BDSDMAC if BR2_LRD_DEVEL_BUILD
```

## package/summit-firmware-lwb-if/Config.in
```kconfig
menuconfig BR2_PACKAGE_SUMMIT_FIRMWARE_LWB_IF
	bool "Sona IF/Sterling LWBx Series Radio Firmware"
	select BR2_PACKAGE_WIRELESS_REGDB
	select BR2_PACKAGE_SUMMIT_FIRMWARE_DEVEL if BR2_LRD_DEVEL_BUILD

if BR2_PACKAGE_SUMMIT_FIRMWARE_LWB_IF

config BR2_PACKAGE_SUMMIT_FIRMWARE_LWB_IF_IF573_SDIO
	bool "Sona IF573 SDIO"
	select BR2_PACKAGE_SUMMIT_FIRMWARE_DEVEL_CYW55573_SDIO if BR2_LRD_DEVEL_BUILD
	help
	  Firmware package for the Sona IF573 SDIO/UART module.

config BR2_PACKAGE_SUMMIT_FIRMWARE_LWB_IF_IF573_PCIE
	bool "Sona IF573 PCIE"
	select BR2_PACKAGE_SUMMIT_FIRMWARE_DEVEL_CYW55573_PCIE if BR2_LRD_DEVEL_BUILD
	help
	  Firmware package for the Sona IF573 PCIE/UART module.

config BR2_PACKAGE_SUMMIT_FIRMWARE_LWB_IF_IF513_DIV
	bool "Sona IF513 (Diversity)"
	select BR2_PACKAGE_SUMMIT_FIRMWARE_DEVEL_CYW55513_SDIO_DIV if BR2_LRD_DEVEL_BUILD
	help
	  Firmware package for the Sona IF513 module with diversity antenna support.

config BR2_PACKAGE_SUMMIT_FIRMWARE_LWB_IF_IF513_SA
	bool "Sona IF513 (Single Antenna)"
	select BR2_PACKAGE_SUMMIT_FIRMWARE_DEVEL_CYW55513_SDIO_SA if BR2_LRD_DEVEL_BUILD
	help
	  Firmware package for the Sona IF513 module with a single antenna.

config BR2_PACKAGE_SUMMIT_FIRMWARE_LWB_IF_LWB5PLUS_SDIO_DIV
	bool "Sterling LWB5+ SDIO M.2 (Diversity)"
	select BR2_PACKAGE_SUMMIT_FIRMWARE_DEVEL_BCM4373_SDIO_DIV if BR2_LRD_DEVEL_BUILD
	help
	  Firmware package for the Sterling LWB5+ M.2 2230 SDIO/UART module
	  with diversity antenna support.

config BR2_PACKAGE_SUMMIT_FIRMWARE_LWB_IF_LWB5PLUS_SDIO_SA
	bool "Sterling LWB5+ SDIO (Single Antenna)"
	select BR2_PACKAGE_SUMMIT_FIRMWARE_DEVEL_BCM4373_SDIO_SA if BR2_LRD_DEVEL_BUILD
	help
	  Firmware package for the Sterling LWB5+ SDIO/UART module
	  with a single antenna.

config BR2_PACKAGE_SUMMIT_FIRMWARE_LWB_IF_LWB5PLUS_SDIO_SA_M2
	bool "Sterling LWB5+ SDIO M.2 (Single Antenna)"
	select BR2_PACKAGE_SUMMIT_FIRMWARE_DEVEL_BCM4373_SDIO_SA_M2 if BR2_LRD_DEVEL_BUILD
	help
	  Firmware package for the Sterling LWB5+ M.2 2230 SDIO/UART module
	  with diversity antenna support.
	  This is a special configuration used when only ANT0 is populated and the
	  other antenna is terminated.

config BR2_PACKAGE_SUMMIT_FIRMWARE_LWB_IF_LWB5PLUS_USB_DIV
	bool "Sterling LWB5+ USB M.2 (Diversity)"
	select BR2_PACKAGE_SUMMIT_FIRMWARE_DEVEL_BCM4373_USB_DIV if BR2_LRD_DEVEL_BUILD
	help
	  Firmware package for the Sterling LWB5+ M.2 2230 USB/USB module
	  with diversity antenna support.

config BR2_PACKAGE_SUMMIT_FIRMWARE_LWB_IF_LWB5PLUS_USB_SA
	bool "Sterling LWB5+ USB (Single Antenna) and Dongle"
	select BR2_PACKAGE_SUMMIT_FIRMWARE_DEVEL_BCM4373_USB_SA if BR2_LRD_DEVEL_BUILD
	help
	  Firmware package for the Sterling LWB5+ USB/USB module
	  with a single antenna. 
	  This package is also used with the LWB5+ USB dongle.

config BR2_PACKAGE_SUMMIT_FIRMWARE_LWB_IF_LWB5PLUS_USB_SA_M2
	bool "Sterling LWB5+ USB M.2 (Single Antenna)"
	select BR2_PACKAGE_SUMMIT_FIRMWARE_DEVEL_BCM4373_USB_SA_M2 if BR2_LRD_DEVEL_BUILD
	help
	  Firmware package for the Sterling LWB5+ M.2 2230 USB/USB module
	  with diversity antenna support.
	  This is a special configuration used when only ANT0 is populated and the
	  other antenna is terminated.

config BR2_PACKAGE_SUMMIT_FIRMWARE_LWB_IF_LWBPLUS
	bool "Sterling LWB+"
	select BR2_PACKAGE_SUMMIT_FIRMWARE_DEVEL_BCM43439 if BR2_LRD_DEVEL_BUILD
	help
	  Firmware package for the Sterling LWB+ module.

config BR2_PACKAGE_SUMMIT_FIRMWARE_LWB_IF_LWB
	bool "Sterling LWB"
	select BR2_PACKAGE_SUMMIT_FIRMWARE_DEVEL_BCM4343 if BR2_LRD_DEVEL_BUILD
	help
	  Firmware package for the Sterling LWB module.

config BR2_PACKAGE_SUMMIT_FIRMWARE_LWB_IF_REGDOMAIN
	string "Regulatory Domain"
	help
	  Country code setting
	  See the Regulatory Release Notes for the set of supported countries.

endif
```

## package/summit-firmware-mt320-sdio/Config.in
```kconfig
config BR2_PACKAGE_SUMMIT_FIRMWARE_MT320_SDIO
	bool "MediaTek MT320 SDIO (WiFi+Bluetooth)"
	select BR2_PACKAGE_SUMMIT_FIRMWARE_DEVEL if BR2_LRD_DEVEL_BUILD
	help
	  Firmware package for the MediaTek MT320 radio with SDIO interface.
	  Includes WiFi and Bluetooth support via SDIO.

if BR2_PACKAGE_SUMMIT_FIRMWARE_MT320_SDIO

config BR2_PACKAGE_SUMMIT_FIRMWARE_MT320_REGDOMAIN
	string "MediaTek MT320 regulatory domain"
	help
	  Two-letter country code passed to the MT320 WLAN module. Leave
	  empty when the country is provisioned later.

endif
```

## package/summit-firmware-nx/Config.in
```kconfig
menuconfig BR2_PACKAGE_SUMMIT_FIRMWARE_NX
	bool "Sona NX61x Radio Firmware"
	select BR2_PACKAGE_WIRELESS_REGDB
	select BR2_PACKAGE_SUMMIT_FIRMWARE_DEVEL if BR2_LRD_DEVEL_BUILD

if BR2_PACKAGE_SUMMIT_FIRMWARE_NX

config BR2_PACKAGE_SUMMIT_FIRMWARE_NX61X
	bool "Sona NX61x SIPT/M.2 1216/M.2 2230 firmware"
	select BR2_PACKAGE_SUMMIT_FIRMWARE_DEVEL_NX61X if BR2_LRD_DEVEL_BUILD
	help
		Sona NX61x firmware package for the SIPT, M.2 1216, and M.2 2230 modules

config BR2_PACKAGE_SUMMIT_FIRMWARE_NX61X_1218
	bool "Sona NX61x M.2 1218 firmware"
	select BR2_PACKAGE_SUMMIT_FIRMWARE_DEVEL_NX61X_1218 if BR2_LRD_DEVEL_BUILD
	help
		Sona NX61x firmware package for the M.2 1218 module with integrated
		chip antenna

choice
	prompt "Sona NX61x Bluetooth interface type"
	default BR2_PACKAGE_SUMMIT_FIRMWARE_NX61X_SERDEV

config BR2_PACKAGE_SUMMIT_FIRMWARE_NX61X_SERDEV
	bool "Sona NX61x Bluetooth serdev support"
	help
		Select this in addition to the appropriate Sona NX61x firmware package
		to enable serdev Bluetooth client support

config BR2_PACKAGE_SUMMIT_FIRMWARE_NX61X_BTATTACH
	bool "Sona NX61x Bluetooth btattach support"
	help
		Select this in addition to the appropriate Sona NX61x firmware package
		to enable btattach Bluetooth client support

endchoice

endif
```
