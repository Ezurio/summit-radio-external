## package/summit-firmware-ti/Config.in
```kconfig
menuconfig BR2_PACKAGE_SUMMIT_FIRMWARE_TI
	bool "Sona TI Radio Firmware"
	select BR2_PACKAGE_WIRELESS_REGDB
	select BR2_PACKAGE_SUMMIT_FIRMWARE_DEVEL if BR2_LRD_DEVEL_BUILD
	select BR2_PACKAGE_SUMMIT_WIRELESS_REGDB if BR2_LRD_DEVEL_BUILD

if BR2_PACKAGE_SUMMIT_FIRMWARE_TI

config BR2_PACKAGE_SUMMIT_FIRMWARE_TI_351_WW
	bool "Sona TI351 Limited World Wide Support"
	select BR2_PACKAGE_SUMMIT_FIRMWARE_DEVEL_TI351_WW if BR2_LRD_DEVEL_BUILD
	default y
	help
	  Firmware package for the Sona TI351 with support for
	  all countries listed in the Regulatory Release Notes.
	  Channel support and power may be limited to ensure compliance
	  in all supported regions.
	  Only countries listed in the Regulatory Release Notes are supported.

config BR2_PACKAGE_SUMMIT_FIRMWARE_TI_351_AU
	bool "Sona TI351 (Australia/New Zealand)"
	select BR2_PACKAGE_SUMMIT_FIRMWARE_DEVEL_TI351_AU if BR2_LRD_DEVEL_BUILD
	help
	  Firmware package for the Sona TI351 with optimized support for
	  use in Australia and New Zealand. Operation outside
	  Australia/New Zealand is not permitted.
	  Please contact Ezurio for access and more details.

config BR2_PACKAGE_SUMMIT_FIRMWARE_TI_351_CA
	bool "Sona TI351 (Canada)"
	select BR2_PACKAGE_SUMMIT_FIRMWARE_DEVEL_TI351_CA if BR2_LRD_DEVEL_BUILD
	help
	  Firmware package for the Sona TI351 with optimized support for
	  use in Canada. Operation outside Canada is not permitted.
	  Please contact Ezurio for access and more details.

config BR2_PACKAGE_SUMMIT_FIRMWARE_TI_351_EU
	bool "Sona TI351 (EU)"
	select BR2_PACKAGE_SUMMIT_FIRMWARE_DEVEL_TI351_EU if BR2_LRD_DEVEL_BUILD
	help
	  Firmware package for the Sona TI351 with optimized support for
	  use in EU member countries and the UK. Operation outside EU member countries
	  and the UK is not permitted.
	  Please contact Ezurio for access and more details.

config BR2_PACKAGE_SUMMIT_FIRMWARE_TI_351_JP
	bool "Sona TI351 (Japan)"
	select BR2_PACKAGE_SUMMIT_FIRMWARE_DEVEL_TI351_JP if BR2_LRD_DEVEL_BUILD
	help
	  Firmware package for the Sona TI351 with optimized support for
	  use in Japan. Operation outside Japan is not permitted.
	  Please contact Ezurio for access and more details.

config BR2_PACKAGE_SUMMIT_FIRMWARE_TI_351_US
	bool "Sona TI351 (United States)"
	select BR2_PACKAGE_SUMMIT_FIRMWARE_DEVEL_TI351_US if BR2_LRD_DEVEL_BUILD
	help
	  Firmware package for the Sona TI351 with optimized support for
	  use in the United States. Operation outside the United States is not permitted.
	  Please contact Ezurio for access and more details.

endif
```

## package/summit-hostapd/Config.in
```kconfig
menuconfig BR2_PACKAGE_SUMMIT_HOSTAPD
	bool "Summit hostapd"
	select BR2_PACKAGE_LIBNL
	select BR2_PACKAGE_OPENSSL
	help
	  Summit hostapd

if BR2_PACKAGE_SUMMIT_HOSTAPD

config BR2_PACKAGE_SUMMIT_HOSTAPD_CLI
	bool "Install hostapd_cli binary"
	help
	  Install hostapd_cli command line utility

endif
```

## package/summit-linux-backports/Config.in
```kconfig
comment "summit-linux-backports needs a Linux kernel to be built"
	depends on !BR2_LINUX_KERNEL

menuconfig BR2_PACKAGE_SUMMIT_LINUX_BACKPORTS
	bool "Summit Linux Backports / Wi-Fi & Bluetooth drivers"
	depends on BR2_LINUX_KERNEL
	help
	  The linux-backports package includes many Linux drivers from
	  recent kernels, backported to older ones.

if BR2_PACKAGE_SUMMIT_LINUX_BACKPORTS

choice
	prompt "Linux kernel driver backports configuration"
	default BR2_PACKAGE_SUMMIT_LINUX_BACKPORTS_USE_DEFCONFIG

config BR2_PACKAGE_SUMMIT_LINUX_BACKPORTS_USE_DEFCONFIG
	bool "Using an in-tree defconfig file"

config BR2_PACKAGE_SUMMIT_LINUX_BACKPORTS_USE_CUSTOM_CONFIG
	bool "Using a custom (def)config file"

endchoice

config BR2_PACKAGE_SUMMIT_LINUX_BACKPORTS_DEFCONFIG
	string "Backports defconfig name"
	depends on BR2_PACKAGE_SUMMIT_LINUX_BACKPORTS_USE_DEFCONFIG
	default "bdimx8"         if BR2_SUMMIT_COMBO_IMAGE_RADIO && BR2_PACKAGE_BLUEZ5_UTILS
	default "bdimx8_nbt"     if BR2_SUMMIT_COMBO_IMAGE_RADIO
	default "som8mplus"      if BR2_SUMMIT_SOM8MP_RADIO && BR2_PACKAGE_BLUEZ5_UTILS
	default "som8mplus_nbt"  if BR2_SUMMIT_SOM8MP_RADIO
	default "som60_fips"     if BR2_SUMMIT_SOM60_RADIO && BR2_PACKAGE_BLUEZ5_UTILS && BR2_SUMMIT_FIPS_RADIO
	default "som60_nbt_fips" if BR2_SUMMIT_SOM60_RADIO && BR2_SUMMIT_FIPS_RADIO
	default "som60"          if BR2_SUMMIT_SOM60_RADIO && BR2_PACKAGE_BLUEZ5_UTILS
	default "som60_nbt"      if BR2_SUMMIT_SOM60_RADIO
	default "wb50n_fips"     if BR2_SUMMIT_50_RADIO && BR2_SUMMIT_FIPS_RADIO && BR2_PACKAGE_BLUEZ5_UTILS
	default "wb50n_nbt_fips" if BR2_SUMMIT_50_RADIO && BR2_SUMMIT_FIPS_RADIO
	default "wb50n"          if BR2_SUMMIT_50_RADIO && BR2_PACKAGE_BLUEZ5_UTILS
	default "wb50n_nbt"      if BR2_SUMMIT_50_RADIO
	default "wb45n_fips"     if BR2_SUMMIT_WB45N_LEGACY_RADIO && BR2_SUMMIT_FIPS_RADIO && BR2_PACKAGE_BLUEZ5_UTILS
	default "wb45n_nbt_fips" if BR2_SUMMIT_WB45N_LEGACY_RADIO && BR2_SUMMIT_FIPS_RADIO
	default "wb45n"          if BR2_SUMMIT_WB45N_LEGACY_RADIO && BR2_PACKAGE_BLUEZ5_UTILS
	default "wb45n_nbt"      if BR2_SUMMIT_WB45N_LEGACY_RADIO
	default "summit60"       if BR2_PACKAGE_SUMMIT_FIRMWARE_60 && BR2_PACKAGE_BLUEZ5_UTILS
	default "summit60_nbt"   if BR2_PACKAGE_SUMMIT_FIRMWARE_60
	default "lwb"            if BR2_PACKAGE_SUMMIT_FIRMWARE_LWB && BR2_PACKAGE_BLUEZ5_UTILS
	default "lwb_nbt"        if BR2_PACKAGE_SUMMIT_FIRMWARE_LWB
	default "sona_nx611"     if BR2_PACKAGE_SUMMIT_FIRMWARE_NX && BR2_PACKAGE_BLUEZ5_UTILS
	default "sona_nx611_nbt" if BR2_PACKAGE_SUMMIT_FIRMWARE_NX
	default "sona_ti"        if BR2_PACKAGE_SUMMIT_FIRMWARE_TI && BR2_PACKAGE_BLUEZ5_UTILS
	default "sona_ti_nbt"    if BR2_PACKAGE_SUMMIT_FIRMWARE_TI
	help
	  Name of the backports defconfig file to use, without the
	  leading defconfig-. The defconfig is located in defconfigs/
	  directory in the backports tree.

config BR2_PACKAGE_SUMMIT_LINUX_BACKPORTS_CUSTOM_CONFIG_FILE
	string "Configuration file path"
	depends on BR2_PACKAGE_SUMMIT_LINUX_BACKPORTS_USE_CUSTOM_CONFIG
	help
	  Path to the backports configuration file

	  Note: this can be a defconfig file or a complete .config
	  file, which can later be saved back with make
	  linux-update-(def)config.

config BR2_PACKAGE_SUMMIT_LINUX_BACKPORTS_CONFIG_FRAGMENT_FILES
	string "Additional configuration fragment files"
	help
	  A space-separated list of configuration fragment files, that
	  will be merged to the main linux-backports configuration file.

endif # BR2_PACKAGE_SUMMIT_LINUX_BACKPORTS
```

## package/summit-mfg611/Config.in
```kconfig
menuconfig BR2_PACKAGE_SUMMIT_MFG611
	bool "Sona NX 611 manufacturing tools binaries"
	select BR2_PACKAGE_LIBNL
	select BR2_PACKAGE_LIBEDIT
	select BR2_PACKAGE_MFG611 if BR2_LRD_DEVEL_BUILD
	help
	  This package installs Sona NX 611 manufacturing tools.

if BR2_PACKAGE_SUMMIT_MFG611

config BR2_PACKAGE_SUMMIT_MFG611_LMU
	bool "Sona NX 611 manufacturing tool (lmu)"
	default y
	select BR2_PACKAGE_MFG611_LMU if BR2_LRD_DEVEL_BUILD
	help
	  This package installs Sona NX 611 lmu for use in setting the regulatory domain.

endif
```

## package/summit-regcypress/Config.in
```kconfig
config BR2_PACKAGE_SUMMIT_REGCYPRESS
	bool "LWB manufacturing tools binaries"
	select BR2_PACKAGE_LIBNL
	select BR2_PACKAGE_LIBEDIT
	select BR2_PACKAGE_WL_FMAC if BR2_LRD_DEVEL_BUILD
	select BR2_PACKAGE_SUMMIT_FIRMWARE_DEVEL if BR2_LRD_DEVEL_BUILD
	select BR2_PACKAGE_SUMMIT_FIRMWARE_DEVEL_BCM4343_MFG if BR2_LRD_DEVEL_BUILD
	help
	  This package installs LWB manufacturing tools.
```

## package/summit-supplicant/Config.in
```kconfig
menuconfig BR2_PACKAGE_SUMMIT_SUPPLICANT
	bool "Summit Supplicant"
	select BR2_PACKAGE_LIBNL
	select BR2_PACKAGE_OPENSSL
	help
	  Summit Supplicant

if BR2_PACKAGE_SUMMIT_SUPPLICANT

config BR2_PACKAGE_SUMMIT_SUPPLICANT_CLI
	bool "Install wpa_cli binary"
	help
	  Install wpa_cli command line utility

config BR2_PACKAGE_SUMMIT_SUPPLICANT_PASSPHRASE
	bool "Install wpa_passphrase binary"
	help
	  Install wpa_passphrase command line utility.

config BR2_PACKAGE_SUMMIT_SUPPLICANT_WPA_CLIENT_SO
	bool "Install wpa_client shared library"
	depends on !BR2_STATIC_LIBS
	help
	  Install libwpa_client.so.

config BR2_PACKAGE_SUMMIT_SUPPLICANT_DBUS
	bool "Enable support for the DBus control interface"
	depends on BR2_TOOLCHAIN_HAS_THREADS # dbus
	depends on !BR2_PACKAGE_SUMMIT_SUPPLICANT_LEGACY
	select BR2_PACKAGE_DBUS
	default y
	help
	  Enable support for the DBus control interface.

config BR2_PACKAGE_SUMMIT_SUPPLICANT_LEGACY
	bool "Summit Supplicant Legacy"
	select BR2_PACKAGE_SUMMIT_SUPPLICANT_LIBS if (BR2_SUMMIT_WB50N_LEGACY_RADIO || BR2_SUMMIT_WB45N_LEGACY_RADIO) && !BR2_PACKAGE_SUMMIT_SUPPLICANT_LIBS_LOCAL
	select BR2_PACKAGE_SUMMIT_SUPPLICANT_LIBS_LEGACY if (BR2_SUMMIT_WB50N_LEGACY_RADIO || BR2_SUMMIT_WB45N_LEGACY_RADIO) && !BR2_PACKAGE_SUMMIT_SUPPLICANT_LIBS_LOCAL

config BR2_PACKAGE_SUMMIT_SUPPLICANT_FIPS
	bool "Enable FIPS mode"
	help
	  Enables FIPS mode

config BR2_PACKAGE_SUMMIT_SUPPLICANT_DBUS_P2P_ENABLED
	bool "DBUS P2P Interfaces Enabled"
	depends on BR2_PACKAGE_SUMMIT_SUPPLICANT_DBUS
	help
	  If dbus p2p is disabled, installs dbus_overlay.conf with p2p_disabled=1,
	  run-time disabling P2P.

config BR2_PACKAGE_SUMMIT_SUPPLICANT_LIBS_LOCAL
	bool "Internal build of the closed source libraries"
	select BR2_PACKAGE_SUMMIT_SUPPLICANT_LIBS_BUILD

config BR2_PACKAGE_SUMMIT_SUPPLICANT_LIBS_BUILD
	bool
	select BR2_PACKAGE_SDCSDK if BR2_PACKAGE_SUMMIT_SUPPLICANT_LEGACY
	select BR2_PACKAGE_SDCCLI if BR2_PACKAGE_SUMMIT_SUPPLICANT_LEGACY

endif
```
