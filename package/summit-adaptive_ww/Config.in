## package/summit-adaptive_ww/Config.in
```kconfig
menuconfig BR2_PACKAGE_SUMMIT_ADAPTIVE_WW
	bool "Summit Adaptive World Mode Binaries Installer"
	select BR2_PACKAGE_LIBNL
	select BR2_PACKAGE_ADAPTIVE_WW if BR2_LRD_DEVEL_BUILD
	select BR2_PACKAGE_ADAPTIVE_WW_CFG_WW if BR2_LRD_DEVEL_BUILD

	help
	  Extracts adaptive_ww from adaptive_ww-arm release and installs them on the target.

if BR2_PACKAGE_SUMMIT_ADAPTIVE_WW

config BR2_PACKAGE_SUMMIT_ADAPTIVE_WW_CFG_FILE
	string "Additional Configuration File"
	help
		Path and filename for runtinme configuration settings

choice
	prompt "AWM's interface preference"
	default BR2_PACKAGE_SUMMIT_ADAPTIVE_WW_INTF_STA

config BR2_PACKAGE_SUMMIT_ADAPTIVE_WW_INTF_STA
	bool "STA"
	help
		Use managed interfaces when available.

config BR2_PACKAGE_SUMMIT_ADAPTIVE_WW_INTF_AP
	bool "AP"
	help
		Use AP interfaces when available.

config BR2_PACKAGE_SUMMIT_ADAPTIVE_WW_INTF_NONE
	bool "NONE"
	help
		Use the first available interface.

endchoice

choice
	prompt "AWM's operating mode"
	default BR2_PACKAGE_SUMMIT_ADAPTIVE_WW_MODE_FULL

config BR2_PACKAGE_SUMMIT_ADAPTIVE_WW_MODE_FULL
	bool "Full"
	help
		AWM mode which requires periodic geo-location validation.
config BR2_PACKAGE_SUMMIT_ADAPTIVE_WW_MODE_LITE
	bool "Lite"
	help
		AWM mode which does not periodically validate geo-location.

endchoice

config BR2_PACKAGE_ADAPTIVE_WW_CFG_WW
	bool "Configure World Wide Utility"
	help
		Extracts cww from adaptive_ww-arm release and installs it on the target.

endif
```

## package/summit-bt-uart-scripts-60/Config.in
```kconfig
menuconfig BR2_PACKAGE_SUMMIT_BT_UART_SCRIPTS_60
	bool "Summit Bluetooth UART Scripts for 60 Radio"
	depends on BR2_PACKAGE_BLUEZ5_UTILS
	help
	  Summit Bluetooth UART Scripts for 60 Radio

if BR2_PACKAGE_SUMMIT_BT_UART_SCRIPTS_60

config BR2_PACKAGE_SUMMIT_BT_UART_SCRIPTS_60_PORT
	string "Bluetooth UART Port"
	default "/dev/ttyS1"
	help
	  Bluetooth UART Port

config BR2_PACKAGE_SUMMIT_BT_UART_SCRIPTS_60_BAUD
	int "Bluetooth UART Baudrate"
	default 3000000
	help
	  Bluetooth UART Baudrate

endif
```

## package/summit-firmware-60/Config.in
```kconfig
menuconfig BR2_PACKAGE_SUMMIT_FIRMWARE_60
	bool "60 Series Radio Firmware"
	select BR2_PACKAGE_SUMMIT_FIRMWARE_DEVEL if BR2_LRD_DEVEL_BUILD
	select BR2_PACKAGE_SUMMIT_WIRELESS_REGDB if BR2_LRD_DEVEL_BUILD

if BR2_PACKAGE_SUMMIT_FIRMWARE_60

config BR2_PACKAGE_SUMMIT_FIRMWARE_60_SDIO_UART
	bool "SDIO-UART"
	select BR2_PACKAGE_SUMMIT_FIRMWARE_DEVEL_LRDMWL_60_SDIO_UART if BR2_LRD_DEVEL_BUILD

config BR2_PACKAGE_SUMMIT_FIRMWARE_60_SDIO_SDIO
	bool "SDIO-SDIO"
	select BR2_PACKAGE_SUMMIT_FIRMWARE_DEVEL_LRDMWL_60_SDIO_SDIO if BR2_LRD_DEVEL_BUILD

config BR2_PACKAGE_SUMMIT_FIRMWARE_60_PCIE_UART
	bool "PCIE-UART"
	select BR2_PACKAGE_SUMMIT_FIRMWARE_DEVEL_LRDMWL_60_PCIE_UART if BR2_LRD_DEVEL_BUILD

config BR2_PACKAGE_SUMMIT_FIRMWARE_60_PCIE_USB
	bool "PCIE-USB"
	select BR2_PACKAGE_SUMMIT_FIRMWARE_DEVEL_LRDMWL_60_PCIE_USB if BR2_LRD_DEVEL_BUILD

config BR2_PACKAGE_SUMMIT_FIRMWARE_60_USB_USB
	bool "USB-USB"
	select BR2_PACKAGE_SUMMIT_FIRMWARE_DEVEL_LRDMWL_60_USB_USB if BR2_LRD_DEVEL_BUILD

config BR2_PACKAGE_SUMMIT_FIRMWARE_60_SOM8MP
	bool "Summit SOM8MP"
	select BR2_PACKAGE_SUMMIT_FIRMWARE_DEVEL_LRDMWL_SOM8MP if BR2_LRD_DEVEL_BUILD

endif
```

## package/summit-firmware-msd/Config.in
```kconfig
menuconfig BR2_PACKAGE_SUMMIT_FIRMWARE_MSD
	bool "MSD/WB Radio Firmware"
	select BR2_PACKAGE_SUMMIT_FIRMWARE_DEVEL if BR2_LRD_DEVEL_BUILD
	select BR2_PACKAGE_SUMMIT_WIRELESS_REGDB if BR2_LRD_DEVEL_BUILD

if BR2_PACKAGE_SUMMIT_FIRMWARE_MSD

config BR2_PACKAGE_SUMMIT_FIRMWARE_MSD_45
	bool "MSD45/WB45"
	select BR2_PACKAGE_SUMMIT_FIRMWARE_DEVEL_AR6003 if BR2_LRD_DEVEL_BUILD

config BR2_PACKAGE_SUMMIT_FIRMWARE_MSD_50
	bool "MSD50/WB50"
	select BR2_PACKAGE_SUMMIT_FIRMWARE_DEVEL_AR6004 if BR2_LRD_DEVEL_BUILD

endif
```

## package/summit-mfg60n/Config.in
```kconfig
config BR2_PACKAGE_SUMMIT_MFG60N
	bool "60 series manufacturing tools binaries"
	select BR2_PACKAGE_LIBNL
	select BR2_PACKAGE_LIBEDIT
	select BR2_PACKAGE_MFG60N if BR2_LRD_DEVEL_BUILD
	select BR2_PACKAGE_MFG60N_CUSTOM if BR2_LRD_DEVEL_BUILD
	select BR2_PACKAGE_SUMMIT_FIRMWARE_DEVEL if BR2_LRD_DEVEL_BUILD
	select BR2_PACKAGE_SUMMIT_FIRMWARE_DEVEL_LRDMWL_SD8997_MFG if BR2_LRD_DEVEL_BUILD
	help
	  This package installs 60 series manufacturing tools.

if BR2_PACKAGE_SUMMIT_MFG60N
config BR2_PACKAGE_SUMMIT_MFG60N_LMU
	bool "60 series manufacturing tool (lmu)"
	default y
	select BR2_PACKAGE_MFG60N_LMU if BR2_LRD_DEVEL_BUILD
	help
	  This package installs 60 series lmu for use in setting the regulatory domain.

config BR2_PACKAGE_SUMMIT_MFG60N_REGULATORY
	bool "60 series regulatory tools (lru, btlru)"
	default y
	select BR2_PACKAGE_MFG60N_LRU if BR2_LRD_DEVEL_BUILD
	select BR2_PACKAGE_MFG60N_BTLRU if BR2_LRD_DEVEL_BUILD
	help
	  This package installs 60 series lru and btlru for use in regulatory testing.

endif
```

## package/summit-network-manager/Config.in
```kconfig
menuconfig BR2_PACKAGE_SUMMIT_NETWORK_MANAGER
	bool "summit-networkmanager"
	depends on !BR2_STATIC_LIBS # gnutls
	depends on BR2_USE_MMU # dbus
	depends on BR2_PACKAGE_HAS_UDEV
	# Tested with 3.2, but may even work with earlier versions
	depends on BR2_TOOLCHAIN_HEADERS_AT_LEAST_3_2
	depends on BR2_TOOLCHAIN_USES_GLIBC # CLOCK_BOOTTIME, IPTOS_CLASS_*
	depends on BR2_TOOLCHAIN_HAS_THREADS # libglib2
	depends on BR2_USE_WCHAR # libglib2
	select BR2_PACKAGE_DBUS
	select BR2_PACKAGE_OPENSSL
	select BR2_PACKAGE_LIBGLIB2
	select BR2_PACKAGE_LIBNDP
	select BR2_PACKAGE_UTIL_LINUX
	select BR2_PACKAGE_UTIL_LINUX_LIBUUID
	help
	  NetworkManager is a set of co-operative tools that make
	  networking simple and straightforward. Whether WiFi, wired,
	  3G, or Bluetooth, NetworkManager allows you to quickly move
	  from one network to another: once a network has been
	  configured and joined once, it can be detected and re-joined
	  automatically the next time it's available.

	  http://projects.gnome.org/NetworkManager/

if BR2_PACKAGE_SUMMIT_NETWORK_MANAGER

choice
	prompt "Package Source"
	default BR2_PACKAGE_SUMMIT_NETWORK_MANAGER_TI if BR2_SUMMIT_CORE_TI_RADIO
	default BR2_PACKAGE_SUMMIT_NETWORK_MANAGER_NX if BR2_SUMMIT_CORE_NX_RADIO
	default BR2_PACKAGE_SUMMIT_NETWORK_MANAGER_LWB if BR2_SUMMIT_CORE_LWB_RADIO || BR2_SUMMIT_BD_COMMON_IMAGE_RADIO
	default BR2_PACKAGE_SUMMIT_NETWORK_MANAGER_MSD if BR2_SUMMIT_50_RADIO || BR2_SUMMIT_WB45N_LEGACY_RADIO
	default BR2_PACKAGE_SUMMIT_NETWORK_MANAGER_60

config BR2_PACKAGE_SUMMIT_NETWORK_MANAGER_60
	bool "Using 60 series"

config BR2_PACKAGE_SUMMIT_NETWORK_MANAGER_LWB
	bool "Using LWB/IF series"

config BR2_PACKAGE_SUMMIT_NETWORK_MANAGER_MSD
	bool "Using MSD series"

config BR2_PACKAGE_SUMMIT_NETWORK_MANAGER_NX
	bool "Using NX series"

config BR2_PACKAGE_SUMMIT_NETWORK_MANAGER_TI
	bool "Using TI series"

endchoice

config BR2_PACKAGE_SUMMIT_NETWORK_MANAGER_TUI
	bool "nmtui support"
	select BR2_PACKAGE_NEWT
	help
	  This option enables terminal based UI

config BR2_PACKAGE_SUMMIT_NETWORK_MANAGER_CLI
	bool "nmcli support"
	select BR2_PACKAGE_LIBEDIT
	default y
	help
	  This option enables support for the NetworkManager Command
	  Line Interface

config BR2_PACKAGE_SUMMIT_NETWORK_MANAGER_MODEM_MANAGER
	bool "modem-manager support"
	select BR2_PACKAGE_MODEM_MANAGER
	select BR2_PACKAGE_MOBILE_BROADBAND_PROVIDER_INFO
	help
	  This option enables support for ModemManager

config BR2_PACKAGE_SUMMIT_NETWORK_MANAGER_PPPD
	bool "pppd support"
	depends on !BR2_TOOLCHAIN_USES_MUSL # pppd
	select BR2_PACKAGE_PPPD
	help
	  This option enables support for PPPD daemon

config BR2_PACKAGE_SUMMIT_NETWORK_MANAGER_OVS
	bool "OpenVSwitch support"
	select BR2_PACKAGE_JANSSON
	help
	  This option enables support for OpenVSwitch

config BR2_PACKAGE_SUMMIT_NETWORK_MANAGER_CONCHECK
	bool "connection checking support"
	select BR2_PACKAGE_LIBCURL
	help
	  This option enables connection checking support

endif

comment "Summit NetworkManager needs udev /dev management and a glibc toolchain w/ headers >= 3.2, dynamic library, wchar, threads"
	depends on BR2_USE_MMU
	depends on !BR2_PACKAGE_HAS_UDEV || \
		!BR2_TOOLCHAIN_HEADERS_AT_LEAST_3_2 || \
		!BR2_TOOLCHAIN_USES_GLIBC || BR2_STATIC_LIBS || \
		!BR2_USE_WCHAR || !BR2_TOOLCHAIN_HAS_THREADS
```

## package/summit-regti351/Config.in
```kconfig
config BR2_PACKAGE_SUMMIT_REGTI351
	bool "TI351 manufacturing tools binaries"
	select BR2_PACKAGE_LIBNL
	select BR2_PACKAGE_LIBEDIT
	select BR2_PACKAGE_LRU_TI if BR2_LRD_DEVEL_BUILD
	help
	  This package installs TI351 series manufacturing tools.
```

## package/summit-supplicant-libs/Config.in
```kconfig
config BR2_PACKAGE_SUMMIT_SUPPLICANT_LIBS
	bool "Summit Supplicant libs"
	depends on BR2_PACKAGE_SUMMIT_SUPPLICANT
	select BR2_PACKAGE_SUMMIT_SUPPLICANT_LIBS_BUILD if BR2_LRD_DEVEL_BUILD

if BR2_PACKAGE_SUMMIT_SUPPLICANT_LIBS

config BR2_PACKAGE_SUMMIT_SUPPLICANT_LIBS_LEGACY
	bool "Summit Supplicant libs Legacy"
	select BR2_PACKAGE_LIBNL
	select BR2_PACKAGE_LIBEDIT
	help
	  Installs required sdcsdk and sdccli

endif
```
